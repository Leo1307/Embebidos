## yocto-docker/layers/meta-rust-opencv/conf/layer.conf
```bitbake
BBPATH .= ":${LAYERDIR}"

BBFILES += "${LAYERDIR}/recipes-*/*/*.bb \
            ${LAYERDIR}/recipes-*/*/*.bbappend"

BBFILE_COLLECTIONS += "meta-rust-opencv"
BBFILE_PATTERN_meta-rust-opencv = "^${LAYERDIR}/"
BBFILE_PRIORITY_meta-rust-opencv = "7"

LAYERSERIES_COMPAT_meta-rust-opencv = "kirkstone"
```
